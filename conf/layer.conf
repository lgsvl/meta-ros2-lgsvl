## conf/layer.conf
```bitbake
# Copyright (c) 2018 LG Electronics, Inc.

BBPATH ?= ""
# We have a conf and classes directory, add to BBPATH
BBPATH .= ":${LAYERDIR}"
# We have recipe directories, add to BBFILES
BBFILES += "${LAYERDIR}/recipes-*/*/*.bb ${LAYERDIR}/recipes-*/*/*.bbappend"

BBFILE_COLLECTIONS += "meta-ros2-lgsvl"
BBFILE_PATTERN_meta-ros2-lgsvl := "^${LAYERDIR}/"
BBFILE_PRIORITY_meta-ros2-lgsvl = "60"


# Override certain PNBLACKLIST items
PNBLACKLIST[poco] = ""
PNBLACKLIST[asio] = ""
PNBLACKLIST[opencv] = ""
```
